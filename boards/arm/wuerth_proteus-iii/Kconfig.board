## boards/arm/wuerth_proteus-iii/Kconfig.board
```kconfig
# Copyright (c) 2021 Nordic Semiconductor ASA
# SPDX-License-Identifier: Apache-2.0

config BOARD_WUERTH_PROTEUS_III
	bool "Wuerth Proteus-III"
	depends on SOC_NRF52840_QIAA
```

## boards/arm/wuerth_proteus-iii/Kconfig.defconfig
```kconfig
# Copyright (c) 2021 Nordic Semiconductor ASA
# SPDX-License-Identifier: Apache-2.0

if BOARD_WUERTH_PROTEUS_III

config BOARD
   default "wuerth_proteus-iii"

config BT_CTLR
   default BT

config SOC_DCDC_NRF52X
   default y

endif
```

## modules/max17048/Kconfig
```kconfig
config MAX17048
	bool "MAX17048 Fuel Gauge"
	depends on I2C
	help
	  Enable I2C-based driver for MAX17048 Fuel Gauge.
```

## modules/max17048/dts/bindings/sensor/maxim,max17048.yaml
```yaml
description: Maxim MAX17048 Fuel Gauge

compatible: "maxim,max17048"

include: i2c-device.yaml

properties:
    enable-sleep:
      type: boolean
      description: Enable sleep in MODE register
```
